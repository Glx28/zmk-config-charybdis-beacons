## config/modules/coach_beacon/Kconfig
```kconfig
DT_COMPAT_ZMK_BEHAVIOR_COACH_BEACON := zmk,behavior-coach-beacon

config ZMK_BEHAVIOR_COACH_BEACON
	bool
	default $(dt_compat_enabled,$(DT_COMPAT_ZMK_BEHAVIOR_COACH_BEACON))
	depends on BT
```

## config/modules/coach_beacon/dts/bindings/behaviors/zmk,behavior-coach-beacon.yaml
```yaml
description: Sends Coach layer state through a private BLE GATT notification.
compatible: "zmk,behavior-coach-beacon"
include: two_param.yaml
```

## config/modules/coach_beacon/dts/bindings/behaviors/zmk,behavior-coach-layer-access.yaml
```yaml
description: Tracks Coach momentary layer holds and persistent layer toggles independently.
compatible: "zmk,behavior-coach-layer-access"
include: two_param.yaml
```

## config/modules/coach_beacon/dts/bindings/behaviors/zmk,behavior-coach-scroll.yaml
```yaml
description: Hold a target layer and scroll layer without deactivating a layer that was already active.
compatible: "zmk,behavior-coach-scroll"
include: one_param.yaml
```

## config/modules/input_processor_jump_accel/Kconfig
```kconfig
# Copyright (c) 2026 The Charybdis Contributors
# SPDX-License-Identifier: MIT

config INPUT_PROCESSOR_JUMP_ACCEL
    bool "Whole-vector jump-curve pointer acceleration input processor"
    default y
    depends on ZMK_POINTING
    help
      Enables a ZMK input processor implementing a RawAccel-style two-zone
      whole-vector acceleration curve for relative pointer input: a flat
      low-speed factor, a smootherstep transition, and a flat high-speed
      factor, driven by whole-vector speed (sqrt(dx^2+dy^2)/dt) rather than
      per-axis speed, with fractional remainder tracking so low factors
      don't quantize slow movement to zero.
```

## config/modules/input_processor_jump_accel/dts/bindings/input/zmk,input-processor-jump-accel.yaml
```yaml
# Copyright (c) 2026 The Charybdis Contributors
# SPDX-License-Identifier: MIT

description: |
  Whole-vector, two-zone "jump" acceleration curve for relative pointer
  input (REL_X/REL_Y). Below jump-start-cps the processor applies a flat
  base-factor; above jump-start-cps + jump-width-cps it applies a flat
  fast-factor; in between it blends the two with a smootherstep curve.
  Speed is computed from the combined (dx, dy) vector magnitude over time,
  not per-axis, so diagonal movement isn't skewed relative to a pure
  horizontal or vertical movement of the same speed.

compatible: "zmk,input-processor-jump-accel"

include: ip_zero_param.yaml

properties:
  base-factor:
    type: int
    required: true
    description: Fixed-point multiplier (x1000) applied below jump-start-cps, e.g. 1000 = 1.0x

  fast-factor:
    type: int
    required: true
    description: Fixed-point multiplier (x1000) applied above jump-start-cps + jump-width-cps

  jump-start-cps:
    type: int
    required: true
    description: Whole-vector speed, in raw sensor counts/sec, where the transition begins

  jump-width-cps:
    type: int
    required: true
    description: Width, in raw sensor counts/sec, of the transition band between the two factors
```

## config/modules/input_processor_pipeline_switch/dts/bindings/behaviors/zmk,behavior-pipeline-switch.yaml
```yaml
# Copyright (c) 2026 Vincent Franco
# SPDX-License-Identifier: MIT

description: |
  Sets the active pipeline of a zmk,input-processor-pipeline-switch
  processor to an absolute index. Vendored change (charybdis-zmk-config):
  takes binding params instead of upstream's zero-param cycle.
  param1 = pipeline index (0..N-1), param2 = persist to flash (0/1).

compatible: "zmk,behavior-pipeline-switch"

include: two_param.yaml

properties:
  processor:
    required: true
    type: phandle
    description: The pipeline-switch input processor to control.
```

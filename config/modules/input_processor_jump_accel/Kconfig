## config/modules/input_processor_jump_accel/Kconfig
```kconfig
# Copyright (c) 2026 The Charybdis Contributors
# SPDX-License-Identifier: MIT

config INPUT_PROCESSOR_JUMP_ACCEL
    bool "Whole-vector jump-curve pointer acceleration input processor"
    default y
    depends on ZMK_POINTING
    help
      Enables a ZMK input processor implementing a RawAccel-style two-zone
      whole-vector acceleration curve for relative pointer input: a flat
      low-speed factor, a configurable smooth transition, and a flat high-speed
      factor. Optional independent speed and accumulated-distance gates prevent
      brief fast movements from receiving high gain. Synchronized vector path
      history preserves diagonal and reversing movement, with fractional
      remainder tracking to avoid quantizing scaled deltas.

DT_COMPAT_ZMK_BEHAVIOR_TRACKBALL_TUNE := zmk,behavior-trackball-tune

config ZMK_BEHAVIOR_TRACKBALL_TUNE
	bool
	default $(dt_compat_enabled,$(DT_COMPAT_ZMK_BEHAVIOR_TRACKBALL_TUNE))
	depends on INPUT_PROCESSOR_JUMP_ACCEL
```

## config/modules/input_processor_jump_accel/dts/bindings/behaviors/zmk,behavior-trackball-tune.yaml
```yaml
# Copyright (c) 2026 The Charybdis Contributors
# SPDX-License-Identifier: MIT

description: Volatile live adjustment controls for a jump acceleration input processor
compatible: "zmk,behavior-trackball-tune"
include: one_param.yaml
properties:
  processor:
    required: true
    type: phandle
    description: Jump acceleration processor to adjust
```

## config/modules/input_processor_jump_accel/dts/bindings/input/zmk,input-processor-jump-accel.yaml
```yaml
# Copyright (c) 2026 The Charybdis Contributors
# SPDX-License-Identifier: MIT

description: |
  Speed-based acceleration for relative pointer input (REL_X/REL_Y). An
  optional independent path-distance gate prevents short fast movements from
  accelerating until enough travel accumulates. Vector mode pairs synchronized
  X/Y samples so diagonal motion and reversals use the complete path.

compatible: "zmk,input-processor-jump-accel"

include: ip_zero_param.yaml

properties:
  base-factor:
    type: int
    required: true
    description: Fixed-point multiplier (x1000) applied below jump-start-cps, e.g. 1000 = 1.0x

  fast-factor:
    type: int
    required: true
    description: Fixed-point multiplier (x1000) applied above jump-start-cps + jump-width-cps

  jump-start-cps:
    type: int
    required: true
    description: Whole-vector speed, in raw sensor counts/sec, where the transition begins

  jump-width-cps:
    type: int
    required: true
    description: Width, in raw sensor counts/sec, of the transition band between the two factors

  curve-type:
    type: string
    enum:
      - smootherstep
      - exponential
      - hockey-stick
    default: smootherstep
    description: |
      Shape of the gain ramp. smootherstep keeps the existing smooth S-curve.
      exponential stays near base-factor through slow and medium motion, then
      rises rapidly toward fast-factor. hockey-stick keeps the early ramp
      gentle and rises more sharply near the high-speed end.

  speed-smoothing-ms:
    type: int
    default: 0
    description: |
      Time constant for low-pass filtering the speed estimate. Zero preserves
      the raw estimate. With a vector window, smoothing updates once per
      synchronized X/Y sample; otherwise it updates per axis event.

  velocity-window-ms:
    type: int
    default: 0
    description: |
      Estimate speed from the sum of per-sample Euclidean X/Y distances over
      this rolling window. Axis events are paired using the sync flag. Zero
      uses the legacy per-event estimate. The window resets after an idle gap
      longer than its duration.

  distance-window-ms:
    type: int
    default: 0
    description: |
      Separate rolling window for accumulated two-dimensional travel. Zero
      disables the distance gate.

  distance-start-counts:
    type: int
    default: 0
    description: Accumulated path counts below which the distance gate stays closed.

  distance-width-counts:
    type: int
    default: 0
    description: |
      Additional accumulated path counts over which the distance gate opens
      smoothly from zero to full acceleration. Zero disables the gate.

  gain-smoothing-ms:
    type: int
    default: 0
    description: |
      Time constant in milliseconds for smoothing the final acceleration factor.
      This can reduce visible gain pumping when the speed estimate varies near
      the middle of the curve. Zero disables gain smoothing.
```

## config/modules/input_processor_jump_accel/dts/bindings/input/zmk,input-processor-motion-smoother.yaml
```yaml
# Copyright (c) 2026 The Charybdis Contributors
# SPDX-License-Identifier: MIT

description: Time-based, fixed-scale relative-motion smoother

compatible: "zmk,input-processor-motion-smoother"

include: ip_zero_param.yaml

properties:
  time-constant-ms:
    type: int
    required: true
    description: First-order temporal smoothing time constant in milliseconds

  scale-x1000:
    type: int
    default: 1000
    description: Fixed, speed-independent output scale in thousandths
```
